## apps/firmware/components/charging_session/Kconfig
```kconfig
menu "chargelatch charging session"

    config CHARGING_SESSION_METER_INTERVAL_SECONDS
        int "Default meter-value interval during a transaction (seconds)"
        default 30
        range 5 3600
        help
            How often devices/<id>/tx/meter is published while a transaction is active. A start
            command may override it per transaction ("interval", same bounds).

endmenu
```

## apps/firmware/components/device_mqtt/Kconfig
```kconfig
menu "chargelatch MQTT"

    config DEVICE_MQTT_BROKER_URI
        string "Broker URI"
        default ""
        help
            Where the device connects once it is on Wi-Fi, e.g. mqtt://broker.example.com:1883.
            The project value is set in sdkconfig.defaults.

            To test against the dev EMQX from `pnpm services:up`, override it here with the LAN
            address of your machine (mqtt://192.168.x.y:1883), NOT localhost: the device is a
            separate host on your Wi-Fi. The override lands in your local, gitignored sdkconfig.
            If this is empty, device_mqtt_start() fails with a clear log line.

    config DEVICE_MQTT_KEEPALIVE_SECONDS
        int "Keepalive (seconds)"
        default 30
        range 5 600
        help
            The broker considers the device gone, and publishes its last will ("offline"), after
            1.5x this long without traffic.

endmenu
```

## apps/firmware/components/meter_telemetry/Kconfig
```kconfig
menu "chargelatch meter telemetry"

    config METER_TELEMETRY_INTERVAL_SECONDS
        int "Read and publish interval (seconds)"
        default 5
        range 2 3600
        help
            How often the meter is read and published to devices/<id>/meter. A full SDM120 read
            takes about 1 s at 2400 baud, so going below 2 s is pointless.

endmenu
```

## apps/firmware/components/provisioning/Kconfig
```kconfig
menu "chargelatch Wi-Fi provisioning"

    choice PROVISIONING_PROV_TRANSPORT
        bool "Provisioning Transport"
        default PROVISIONING_PROV_TRANSPORT_SOFTAP if IDF_TARGET_ESP32S2
        default PROVISIONING_PROV_TRANSPORT_BLE
        help
            Wi-Fi provisioning component offers both, SoftAP and BLE transports. Choose any one.

        config PROVISIONING_PROV_TRANSPORT_BLE
            bool "BLE"
            select BT_ENABLED
            depends on !IDF_TARGET_ESP32S2
        config PROVISIONING_PROV_TRANSPORT_SOFTAP
            bool "Soft AP"
            select LWIP_IPV4
    endchoice

    choice PROVISIONING_PROV_SECURITY_VERSION
        bool "Protocomm security version"
        default PROVISIONING_PROV_SECURITY_VERSION_1
        help
            Security version 1 (X25519 + proof-of-possession) is what the admin mobile app speaks:
            its esp_provisioning_ble library does not implement version 2. Only change this
            together with the app.

        config PROVISIONING_PROV_SECURITY_VERSION_1
            bool "Security version 1"
            select ESP_PROTOCOMM_SUPPORT_SECURITY_VERSION_1

        config PROVISIONING_PROV_SECURITY_VERSION_2
            bool "Security version 2"
            select ESP_PROTOCOMM_SUPPORT_SECURITY_VERSION_2
    endchoice

    config PROVISIONING_PROV_DEV_POP
        string "Development proof-of-possession"
        depends on PROVISIONING_PROV_SECURITY_VERSION_1
        default "abcd1234"
        help
            Shared PoP used only when the application passes none, i.e. on a board that did not
            go through the factory app and so has no per-device PoP. Not a secret: never rely
            on it for deployed devices.

    choice PROVISIONING_PROV_MODE
        bool "Security version 2 mode"
        depends on PROVISIONING_PROV_SECURITY_VERSION_2
        default PROVISIONING_PROV_SEC2_DEV_MODE

        config PROVISIONING_PROV_SEC2_DEV_MODE
            bool "Security version 2 development mode"
            depends on PROVISIONING_PROV_SECURITY_VERSION_2
            help
                This enables the development mode for
                security version 2.
                Please note that this mode is NOT recommended for production purpose.

        config PROVISIONING_PROV_SEC2_PROD_MODE
            bool "Security version 2 production mode"
            depends on PROVISIONING_PROV_SECURITY_VERSION_2
            help
                This enables the production mode for
                security version 2.
    endchoice

    config PROVISIONING_PROV_TRANSPORT
        int
        default 1 if PROVISIONING_PROV_TRANSPORT_BLE
        default 2 if PROVISIONING_PROV_TRANSPORT_SOFTAP

    config PROVISIONING_RESET_PROVISIONED
        bool
        default n
        prompt "Reset provisioned status of the device"
        help
            This erases the NVS to reset provisioned status of the device on every reboot.
            Provisioned status is determined by the Wi-Fi STA configuration, saved on the NVS.

    config PROVISIONING_RESET_PROV_MGR_ON_FAILURE
        bool
        default y
        prompt "Reset provisioned credentials and state machine after session failure"
        help
            Enable reseting provisioned credentials and state machine after session failure.
            This will restart the provisioning service after retries are exhausted.

    config PROVISIONING_PROV_MGR_MAX_RETRY_CNT
        int
        default 5
        prompt "Max retries before reseting provisioning state machine"
        depends on PROVISIONING_RESET_PROV_MGR_ON_FAILURE
        help
            Set the Maximum retry to avoid reconnecting to an inexistent AP or if credentials
            are misconfigured. Provisioned credentials are erased and internal state machine
            is reset after this threshold is reached.

    config PROVISIONING_PROV_USING_BLUEDROID
        bool
        depends on (BT_BLUEDROID_ENABLED && (IDF_TARGET_ESP32C3 || IDF_TARGET_ESP32S3))
        select BT_BLE_42_FEATURES_SUPPORTED
        default y
        help
            This enables BLE 4.2 features for Bluedroid.

    config PROVISIONING_REPROVISIONING
        bool "Re-provisioning"
        help
            Enable re-provisioning - allow the device to provision for new credentials
            after previous successful provisioning.

endmenu
```

## apps/firmware/components/relay_control/Kconfig
```kconfig
menu "chargelatch relay"

    config RELAY_GPIO
        int "Relay trigger GPIO"
        default 26
        help
            Drives the relay module that switches the contactor.

    config RELAY_ACTIVE_HIGH
        bool "Relay is active high"
        default y
        help
            y: GPIO high energises the relay ("high level trigger" modules, transistor drivers).
            n: GPIO low energises it (many opto-isolated relay boards).
            Getting this wrong closes the contactor whenever the firmware thinks it is open,
            including at boot.

    config RELAY_RESTORE_STATE
        bool "Restore the last state after a reboot"
        default y
        help
            y: the on/off state is stored in NVS and re-applied at boot, so the contactor closes
               again by itself after a reset or power cut if it was on before.
            n: always start with the relay off.

endmenu
```

## apps/firmware/components/sdm_meter/Kconfig
```kconfig
menu "chargelatch SDM energy meter"

    # The meter model and serial settings are DEVICE CONFIGURATION, written into the fctry
    # partition by the factory app (see device_identity). The values here are only the defaults
    # for a board without factory data (flashed with idf.py).

    config SDM_METER_DEFAULT_MODEL
        string "Default meter model (no factory data)"
        default "SDM120"
        help
            Name of an sdm_model_t in components/sdm_meter/sdm_registers.c (see meters.json).

    config SDM_METER_DEFAULT_SLAVE_ADDRESS
        int "Default Modbus slave address (no factory data)"
        default 1
        range 1 247

    config SDM_METER_DEFAULT_BAUD_RATE
        int "Default baud rate (no factory data)"
        default 2400
        help
            SDM120 factory default is 2400; SDM630 is 9600.

    config SDM_METER_UART_NUM
        int "UART port"
        default 2
        range 1 2
        help
            UART0 is the console. The devkit's "RX2/TX2" pins are UART2.

    config SDM_METER_TX_GPIO
        int "TX GPIO (to the transceiver's DI)"
        default 17
        help
            "TX2" on ESP32 devkits. Note GPIO16/17 are taken by PSRAM on WROVER modules.

    config SDM_METER_RX_GPIO
        int "RX GPIO (from the transceiver's RO)"
        default 16
        help
            "RX2" on ESP32 devkits.

    config SDM_METER_DE_GPIO
        int "DE / RE GPIO (RS-485 direction)"
        default 4
        help
            Drives the transceiver's DE and /RE pins, tied together (MAX485-style modules): high
            while transmitting, low while listening. The UART hardware toggles it per frame.
            Set to -1 for a transceiver with automatic direction control.

endmenu
```
